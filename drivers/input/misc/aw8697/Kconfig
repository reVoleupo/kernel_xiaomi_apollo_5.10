## drivers/input/misc/aw8697/Kconfig
```kconfig
config INPUT_AW8697_HAPTIC
	tristate "AW8697 haptic vibrator driver"
	depends on I2C
	help
	  Say Y to enable support for the AW8697 I2C haptic vibrator.
	  Used on Xiaomi apollo (Redmi K30S Ultra).
```

## drivers/input/touchscreen/nt36xxx/Kconfig
```kconfig
#
# Novatek NT36xxx touchscreen driver configuration
#

config TOUCHSCREEN_NT36XXX_HOSTDL_SPI
	tristate "Novatek NT36xxx host download SPI touchscreen driver"
	depends on SPI
	help
	  Say Y here if you have a Novatek NT36xxx (NT36523/NT36672/NT36675)
	  touchscreen connected via SPI bus. Used on Xiaomi apollo (Redmi K30S Ultra).

	  If unsure, say N.
```

## drivers/power/supply/ti/Kconfig
```kconfig
config CHARGER_BQ2597X
	tristate "TI BQ2597x charge pump driver"
	depends on I2C
	help
	  Say Y to enable support for TI BQ25970/BQ2597x I2C charge pump.
	  Used on Xiaomi apollo (Redmi K30S Ultra) for 33W charging.
```
